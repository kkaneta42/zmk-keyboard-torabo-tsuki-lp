#include "torabo_tsuki_lp.dtsi"
#include <input/processors.dtsi>
#include <dt-bindings/zmk/input_transform.h>

&trackball_listener {
    input-processors =
        <&zip_xy_transform (INPUT_TRANSFORM_X_INVERT | INPUT_TRANSFORM_Y_INVERT)>,
        <&zip_temp_layer 1 150>;

    // Scroll mode: Convert XY motion to scroll when layer 3 is active
    scroll_mode {
        layers = <3>;
        // Scroll speed scaled to 6.25% and vertical axis inverted before mapping to scroll events
        input-processors = <&zip_xy_scaler 1 16>, <&zip_xy_transform INPUT_TRANSFORM_Y_INVERT>, <&zip_xy_to_scroll_mapper>;
    };
};

&size_s_transform {
    col-offset = <7>;
};

// &size_m_transform {
//     col-offset = <7>;
// };

&size_l_transform {
    col-offset = <7>;
};