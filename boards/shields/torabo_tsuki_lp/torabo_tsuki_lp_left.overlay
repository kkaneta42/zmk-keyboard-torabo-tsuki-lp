#include "torabo_tsuki_lp.dtsi"
#include <input/processors.dtsi>
#include <dt-bindings/zmk/input_transform.h>

&trackball_listener {
    input-processors =
        <&zip_xy_transform (INPUT_TRANSFORM_X_INVERT | INPUT_TRANSFORM_Y_INVERT)>,
        <&zip_temp_layer 1 350>;

    // スクロールモード: layer 3がアクティブな時にXY移動をスクロールに変換
    scroll_mode {
        layers = <3>;
        // スクロール速度を6.25%にスケールし、縦方向の向きを反転してからスクロールイベントに変換
        input-processors = <&zip_xy_scaler 1 16>, <&zip_xy_transform INPUT_TRANSFORM_Y_INVERT>, <&zip_xy_to_scroll_mapper>;
    };
};
